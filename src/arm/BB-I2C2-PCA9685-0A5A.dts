/*
 * Copyright (C) 2015 Robert Nelson <robertcnelson@gmail.com>
 *
 * This program is free software; you can redistribute it and/or modify
 * it under the terms of the GNU General Public License version 2 as
 * published by the Free Software Foundation.
 */
/dts-v1/;
/plugin/;

#include <dt-bindings/board/am335x-bbw-bbb-base.h>
#include <dt-bindings/gpio/gpio.h>
#include <dt-bindings/pinctrl/am33xx.h>

/ {
	compatible = "ti,beaglebone", "ti,beaglebone-black", "ti,beaglebone-green", "ti,unicron";

	/* identification */
	part-number = "BB-I2C2-PCA9685";
	version = "0A5A";

	/* state the resources this cape uses */

	fragment@0 {
		target = <&i2c2>;
		__overlay__ {
			status = "okay";

			clock-frequency = <100000>;

			/* shut up DTC warnings */
			#address-cells = <1>;
			#size-cells = <0>;

			/* pca9685 pwm module 0 */
			pca@7f {
				compatible = "nxp,pca9685-pwm";
				#pwm-cells = <2>;
				reg = <0x7f>;
				/* invert; */
				/* open-drain; */
			};

		};
	};
};
